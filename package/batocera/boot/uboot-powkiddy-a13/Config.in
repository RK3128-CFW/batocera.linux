## package/batocera/boot/uboot-powkiddy-a13/Config.in
```kconfig
config BR2_PACKAGE_UBOOT_POWKIDDY_A13
    bool "uboot files for Powkiddy A13"
    select BR2_TOOLCHAIN_OPTIONAL_LINARO_ARM
    select BR2_PACKAGE_RKBIN
    help
        uboot files for POWKIDDY_A13
```

## package/batocera/controllers/m17-gamepad/Config.in
```kconfig
config BR2_PACKAGE_M17_GAMEPAD
	bool "M17 Gamepad"
       
	help
          M17 Gamepad controller (converts keys to gamepad)
```
